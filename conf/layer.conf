## conf/layer.conf
```bitbake
# We have a conf and classes directory, add to BBPATH
BBPATH .= ":${LAYERDIR}"

# We have a recipes-* directories, add to BBFILES
BBFILES += "${LAYERDIR}/recipes-*/*/*.bb \
	${LAYERDIR}/recipes-*/*/*.bbappend"

BBFILE_COLLECTIONS += "minig4"
BBFILE_PATTERN_minig4 = "^${LAYERDIR}/"
BBFILE_PRIORITY_minig4 = "6"
```

## conf/machine/include/tune-ppc970.inc
```bitbake
DEFAULTTUNE ?= "ppc970"

require conf/machine/include/powerpc/arch-powerpc64.inc

TUNEVALID[ppc970] = "Enable ppc970 specific processor optimizations"
TUNE_CCARGS .= "${@bb.utils.contains('TUNE_FEATURES', 'ppc970', ' -mcpu=970 -mno-spe ', '', d)}"

AVAILTUNES += "ppc970"
TUNE_FEATURES_tune-ppc970 = "m64 fpu-hard ppc970 altivec"
TUNE_PKGARCH_tune-ppc970 = "ppc970"
PACKAGE_EXTRA_ARCHS_tune-ppc970 = "${PACKAGE_EXTRA_ARCHS_tune-powerpc64} ppc970"

# glibc configure options to get 970 specific library (for sqrt)
GLIBC_EXTRA_OECONF += "${@bb.utils.contains('TUNE_FEATURES', 'ppc970', '--with-cpu=power4', '', d)}"
```

## conf/machine/minig4.conf
```bitbake
#@TYPE: Machine
#@NAME: minig4

#@DESCRIPTION: Machine configuration for minig4 systems

TARGET_FPU = ""

include conf/machine/include/tune-ppc7400.inc


TARGET_CC_KERNEL_ARCH = "-mno-spe"

KERNEL_IMAGETYPE = "vmlinux"


SERIAL_CONSOLES ?= "115200;ttyS0 115200;ttyS1"

MACHINE_FEATURES = "keyboard pci ext3 ext4 serial bluetooth  usbgadget usbhost vfat alsa screen apm ethernet"


PREFERRED_PROVIDER_virtual/kernel ?= "linux-yocto"
PREFERRED_VERSION_linux-yocto ?= "4.8%"

PREFERRED_PROVIDER_virtual/xserver ?= "xserver-xorg"
PREFERRED_PROVIDER_virtual/egl ?= "mesa"
PREFERRED_PROVIDER_virtual/libgl ?= "mesa"
PREFERRED_PROVIDER_virtual/libgles1 ?= "mesa"
PREFERRED_PROVIDER_virtual/libgles2 ?= "mesa"

XSERVER ?= "xserver-xorg \
            ${@bb.utils.contains('DISTRO_FEATURES', 'opengl', 'mesa-driver-swrast xserver-xorg-extension-glx', '', d)} \
            xf86-input-evdev \
            xf86-input-mouse \
            xf86-video-fbdev \
            xf86-input-keyboard"


MACHINE_EXTRA_RRECOMMENDS = " kernel-modules"

IMAGE_FSTYPES ?= " tar.bz2"
```

## conf/machine/powermacg5.conf
```bitbake
#@TYPE: Machine
#@NAME: powermacg5

#@DESCRIPTION: Machine configuration for powermacg5 systems

TARGET_FPU = ""

include conf/machine/include/tune-ppc970.inc


TARGET_CC_KERNEL_ARCH = "-mno-spe"

KERNEL_IMAGETYPE = "vmlinux"

SERIAL_CONSOLE = "115200 ttyS0"

MACHINE_FEATURES = "keyboard pci ext2 ext3 serial bluetooth  usbgadget usbhost vfat alsa screen apm ethernet"


PREFERRED_PROVIDER_virtual/kernel ?= "linux-kernel"
PREFERRED_VERSION_linux-yocto ?= "4.14%"

PREFERRED_PROVIDER_virtual/xserver ?= "xserver-xorg"
XSERVER ?= "xserver-xorg \
           xf86-input-evdev \
           xf86-video-fbdev \
           xf86-video-modesetting \
           xf86-video-ati \
           xf86-video-nouveau"

MACHINE_EXTRA_RRECOMMENDS = " kernel-modules linux-firmware "

IMAGE_FSTYPES ?= " tar.bz2"
#JFFS2_ERASEBLOCK = "0x4000"
```
